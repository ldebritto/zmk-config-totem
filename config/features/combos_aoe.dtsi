#include "features/totem_keypos.dtsi"

COMBO(toggle_aoe_layer,     &tog AOE,                   OLK LM0 LM1,   DEF AOE, 60)

COMBO(aoe_left_esc,         &kp ESCAPE,                 LT1 LT2 LT3,       AOE, 60)
COMBO(aoe_left_tab,         &kp TAB,                    LT1     LT3,       AOE, 60)
COMBO(aoe_left_enter,       &hrml LA(LS(LCTRL)) ENTER,  LM1 LM2 LM3,       AOE, 60)
COMBO(aoe_left_backspace,   &hrml LA(LCTRL) BSPC,       LM1     LM3,       AOE, 60)

COMBO(aoe_right_esc,        &kp ESCAPE,                 RT1 RT2 RT3,       AOE, 60)
COMBO(aoe_right_tab,        &kp TAB,                    RT1     RT3,       AOE, 60) 
COMBO(aoe_right_enter,      &hrmr RA(LS(RCTRL)) ENTER,  RM1 RM2 RM3,       AOE, 60) 
COMBO(aoe_right_backspace,  &hrmr LA(LCTRL) BSPC,       RM1     RM3,       AOE, 60)